## Kconfig
```kconfig
config INPUT_EYELASH_TPS43
    bool "eyelash_corne TPS43 trackpad driver"
    default y
    depends on GPIO
    depends on I2C
    depends on INPUT
    depends on DT_HAS_AZOTEQ_IQS5XX_ENABLED
    help
      Build the project-local IQS5xx driver used by the right-half TPS43.
```

## config/west.yml
```yaml
manifest:
  remotes:
    - name: zmkfirmware
      url-base: https://github.com/zmkfirmware
      # Additional modules containing boards/shields/custom code can be listed here as well.
      # See:
      # - https://zmk.dev/docs/features/modules
      # - https://docs.zephyrproject.org/3.5.0/develop/west/manifest.html#projects
    - name: AYM1607
      url-base: https://github.com/AYM1607
    - name: cormoran
      url-base: https://github.com/cormoran
  projects:
    # - name: eyelash_corne
    #   url: https://github.com/a741725193/zmk-new_corne
    #   revision: main
    - name: zmk
      remote: cormoran
      revision: v0.3-branch+dya
      import: app/west.yml
    - name: zmk-driver-azoteq-iqs5xx
      remote: AYM1607
      # Binding/Kconfig dependency only; driver implementation is maintained locally.
      revision: 27321f0232b50f0af31eb27ff97d539933467ea4
    - name: zmk-behavior-runtime-sensor-rotate
      remote: cormoran
      revision: main
    - name: zmk-module-ble-management
      remote: cormoran
      revision: zmk-v0.3.0.0
    - name: zmk-module-battery-history
      remote: cormoran
      revision: main
    - name: zmk-module-settings-rpc
      remote: cormoran
      revision: main
    - name: zmk-module-runtime-input-processor
      remote: cormoran
      revision: zmk-v0.3.0.0
  self:
    path: config
```
